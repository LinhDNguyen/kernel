## sound/soc/fsl/Kconfig
```kconfig
config SND_KINETIS_SOC
    tristate "SoC Audio for the KINETIS chips"
    depends on ARCH_KINETIS && SND_SOC
    select SND_PCM
    help
      Say Y or M if you want to add support for codecs attached to
      the KINETIS I2S or SSP interface.

config SND_SOC_OF_SIMPLE
	tristate
	
config SND_MPC52xx_DMA
	tristate

# ASoC platform support for the Freescale MPC8610 SOC.  This compiles drivers
# for the SSI and the Elo DMA controller.  You will still need to select
# a platform driver and a codec driver.
config SND_SOC_MPC8610
	tristate
	depends on MPC8610

config SND_SOC_MPC8610_HPCD
	tristate "ALSA SoC support for the Freescale MPC8610 HPCD board"
	# I2C is necessary for the CS4270 driver
	depends on MPC8610_HPCD && I2C
	select SND_SOC_MPC8610
	select SND_SOC_CS4270
	select SND_SOC_CS4270_VD33_ERRATA
	default y if MPC8610_HPCD
	help
	  Say Y if you want to enable audio on the Freescale MPC8610 HPCD.

config SND_SOC_MPC5200_I2S
	tristate "Freescale MPC5200 PSC in I2S mode driver"
	depends on PPC_MPC52xx && PPC_BESTCOMM
	select SND_MPC52xx_DMA
	select PPC_BESTCOMM_GEN_BD
	help
	  Say Y here to support the MPC5200 PSCs in I2S mode.

config SND_SOC_MPC5200_AC97
	tristate "Freescale MPC5200 PSC in AC97 mode driver"
	depends on PPC_MPC52xx && PPC_BESTCOMM
	select SND_SOC_AC97_BUS
	select SND_MPC52xx_DMA
	select PPC_BESTCOMM_GEN_BD
	help
	  Say Y here to support the MPC5200 PSCs in AC97 mode.

config SND_MPC52xx_SOC_PCM030
	tristate "SoC AC97 Audio support for Phytec pcm030 and WM9712"
	depends on PPC_MPC5200_SIMPLE
	select SND_SOC_MPC5200_AC97
	select SND_SOC_WM9712
	help
	  Say Y if you want to add support for sound on the Phytec pcm030
	  baseboard.

config SND_MPC52xx_SOC_EFIKA
	tristate "SoC AC97 Audio support for bbplan Efika and STAC9766"
	depends on PPC_EFIKA
	select SND_SOC_MPC5200_AC97
	select SND_SOC_STAC9766
	help
	  Say Y if you want to add support for sound on the Efika.

config SND_KINETIS_SOC_EVK_DEVB
    tristate "SoC Audio support for TWR AUDIO SGTL5000"
    depends on SND_KINETIS_SOC && ARCH_KINETIS
    select SND_SOC_SGTL5000
    help
      Say Y if you want to add support for SoC audio on TWRK70F120M development
      board with the sgtl5000 codec.
```
